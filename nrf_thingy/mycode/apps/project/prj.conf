## CMakeLists.txt
```
# SPDX-License-Identifier: Apache-2.0

cmake_minimum_required(VERSION 3.20.0)
find_package(Zephyr REQUIRED HINTS $ENV{ZEPHYR_BASE})
project(prac3)

include_directories(CMAKE_MODULE_PATH ${CMAKE_CURRENT_SOURCE_DIR}/../../mylib/protocolBuffer/nanopb)
# include_directories(${NANOPB_DIR})  # Include Nanopb headers

target_sources(app PRIVATE src/main.c)
target_sources(app PRIVATE ../../mylib/hci/hci.c)  # Include hci.c as a source file
target_sources(app PRIVATE ../../mylib/bluetooth/bluetooth.c)  # Include bluetooth.c as a source file
target_sources(app PRIVATE ../../mylib/protocolBuffer/hci.pb.c)  # Include hci.pb.c as a source file

target_sources(app PRIVATE 
    ${CMAKE_CURRENT_SOURCE_DIR}/../../mylib/protocolBuffer/nanopb/pb_common.c
    ${CMAKE_CURRENT_SOURCE_DIR}/../../mylib/protocolBuffer/nanopb/pb_encode.c
)
```

## prj.conf
```kconfig
# Zehpyr Configs [Configuration Options]
CONFIG_GPIO=y
CONFIG_PRINTK=y

# Shell
CONFIG_SHELL=y
CONFIG_SHELL_BACKEND_RTT=y
CONFIG_SHELL_LOG_BACKEND=y

# Logging
CONFIG_LOG=y
CONFIG_LOG_CMDS=y
CONFIG_LOG_RUNTIME_FILTERING=y

# UART
CONFIG_SERIAL=y
CONFIG_UART_INTERRUPT_DRIVEN=y

CONFIG_HEAP_MEM_POOL_SIZE=2048

# CONFIG_MAIN_STACK_SIZE=2048
# CONFIG_IDLE_STACK_SIZE=2048

CONFIG_BT=y
CONFIG_BT_SHELL=y
CONFIG_BT_OBSERVER=y
```

## src/main.c
```c
#include <stdlib.h>
#include <stdint.h>
#include <stdbool.h>
#include <stddef.h>

#include <zephyr/kernel.h>
#include <zephyr/device.h>
#include <zephyr/drivers/uart.h>
#include <zephyr/shell/shell.h>

#include <zephyr/types.h>
#include <zephyr/sys/printk.h>
#include <zephyr/sys/util.h>

#include "../../../mylib/hci/hci.h"
#include "../../../mylib/gcu/commands.h"
#include "../../../mylib/bluetooth/bluetooth.h"

#include <zephyr/drivers/gpio.h>

#include <zephyr/logging/log.h>
#include <zephyr/logging/log_ctrl.h>

LOG_MODULE_REGISTER(AHU);

// Main Function
int main(void) {

  init_hci();

  bt_ready();


  while (1) {
    k_msleep(100);
  }

  return 1;
}
```
