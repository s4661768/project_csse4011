## prj.conf
```kconfig
# Zehpyr Configs [Configuration Options]
CONFIG_GPIO=y
CONFIG_PRINTK=y

# Shell
CONFIG_SHELL=y
CONFIG_SHELL_BACKEND_RTT=y
CONFIG_SHELL_LOG_BACKEND=y

# Logging
CONFIG_LOG=y
CONFIG_LOG_CMDS=y
CONFIG_LOG_RUNTIME_FILTERING=y

# UART
CONFIG_SERIAL=y
CONFIG_UART_INTERRUPT_DRIVEN=y

CONFIG_HEAP_MEM_POOL_SIZE=1024

CONFIG_STDOUT_CONSOLE=y
CONFIG_I2C=y
CONFIG_SENSOR=y

CONFIG_CBPRINTF_FP_SUPPORT=y

CONFIG_BT=y
CONFIG_BT_BROADCASTER=y
CONFIG_BT_EXT_ADV=y

CONFIG_BT_OBSERVER=y

CONFIG_MPU6050=y
CONFIG_MPU6050_TRIGGER_NONE=y

CONFIG_MPU9250=y
CONFIG_MPU9250_TRIGGER_NONE=y
```

## src/main.c
```c
#include <zephyr/device.h>
#include <zephyr/drivers/sensor.h>

#include <stdio.h>
#include <zephyr/kernel.h>
#include <zephyr/shell/shell.h>

#include <zephyr/drivers/gpio.h>

#include <zephyr/logging/log.h>
#include <zephyr/logging/log_ctrl.h>

#include "../../../mylib/Thingy:52/sensors/bluetooth/ibeacon.h"
// #include "../../../mylib/Thingy:52/sensors/lis2dh/lis2dh.h"

LOG_MODULE_REGISTER(AHU);

int main(void)
{
	
	return 0;
}
```
